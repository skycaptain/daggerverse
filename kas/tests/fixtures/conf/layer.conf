## kas/tests/fixtures/conf/layer.conf
```bitbake
# Skycaptain: Daggerverse
#
# SPDX-License-Identifier: BSD-3-Clause
#

# We have a conf and classes directory, add to BBPATH
BBPATH .= ":${LAYERDIR}"

# We have recipes-* directories, add to BBFILES
BBFILES += "\
    ${LAYERDIR}/recipes-*/*/*.bb \
    ${LAYERDIR}/recipes-*/*/*.bbappend \
    "

BBFILE_COLLECTIONS += "daggerverse-kas-test"
BBFILE_PATTERN_daggerverse-kas-test = "^${LAYERDIR}/"
BBFILE_PRIORITY_daggerverse-kas-test = "5"

LAYERSERIES_COMPAT_daggerverse-kas-test = "scarthgap"
```
